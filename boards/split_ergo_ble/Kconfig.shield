## boards/split_ergo_ble/Kconfig.shield
```kconfig
config SHIELD_SPLIT_ERGO_BLE_LEFT
    def_bool $(shields_list_contains,split_ergo_ble_left)

config SHIELD_SPLIT_ERGO_BLE_RIGHT
    def_bool $(shields_list_contains,split_ergo_ble_right)
```

## boards/split_ergo_ble/Kconfig.split_ergo_ble_left
```kconfig
config BOARD_SPLIT_ERGO_BLE_LEFT
    select SOC_NRF52840_QIAA
    imply RETAINED_MEM
    imply RETENTION
    imply RETENTION_BOOT_MODE
```

## config/boards/penkeebs_split.conf
```kconfig
# Wireless/BLE
CONFIG_ZMK_BLE=y
CONFIG_ZMK_BLE_EXPERIMENTAL_CONN=y

# Split keyboard transport (UART over the TRRS/wireless)
CONFIG_ZMK_SPLIT=y
CONFIG_ZMK_SPLIT_BLE=y
CONFIG_ZMK_SPLIT_BLE_CENTRAL_PERIPHERALS=1

# Power management
CONFIG_ZMK_SLEEP=y
CONFIG_ZMK_IDLE_SLEEP_TIMEOUT=900000   # 15 minutes

# USB (for flashing)
CONFIG_ZMK_USB=y

# Optional: RGB underglow
# CONFIG_ZMK_RGB_UNDERGLOW=y

# Optional: display
# CONFIG_ZMK_DISPLAY=y
```

## config/boards/shields/pendustries_split/Kconfig.shield
```kconfig
config SHIELD_PENDUSTRIES_SPLIT
    def_bool $(shields_list_contains,PendustriesSplit)
```

## config/boards/shields/penkeebs_split/Kconfig.shield
```kconfig
config SHIELD_PENKEEBS_SPLIT_LEFT
    def_bool $(shields_list_contains,penkeebs_split_left)

config SHIELD_PENKEEBS_SPLIT_RIGHT
    def_bool $(shields_list_contains,penkeebs_split_right)
```

## config/west.yml
```yaml
manifest:
  remotes:
    - name: zmkfirmware
      url-base: https://github.com/zmkfirmware
    - name: kinderdijk
      url-base: https://github.com/kinderdijk

  projects:
    - name: zmk
      remote: zmkfirmware
      revision: v0.3        # pin to a release; swap to main for bleeding edge
      import: app/west.yml

    - name: zmk-keyboard-penkeebs_split
      remote: kinderdijk
      revision: main

    - name: zmk-rgbled-widget
      url: https://github.com/caksoylar/zmk-rgbled-widget
      revision: v0.3

  self:
    path: config
```
